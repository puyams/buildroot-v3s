## squonk42/Config.in
```kconfig
source "$BR2_EXTERNAL_SQUONK42_PATH/package/rtl8723bs_ext/Config.in"
source "$BR2_EXTERNAL_SQUONK42_PATH/package/most/Config.in"

config BR2_PACKAGE_META_FAVORITES
	bool "Select favorite packages"
	select BR2_PACKAGE_DROPBEAR
	select BR2_PACKAGE_SLANG
	select BR2_PACKAGE_MOST
	help
	  The favorite package selection for a nice target environment.
```

## squonk42/configs/squonk42_licheepi_zero_defconfig
```kconfig
BR2_arm=y
BR2_cortex_a7=y
BR2_ARM_FPU_VFPV4=y
BR2_TOOLCHAIN_EXTERNAL=y
BR2_TARGET_GENERIC_HOSTNAME="licheepi-zero"
BR2_TARGET_GENERIC_ISSUE="Welcome to Buildroot for the LicheePi Zero"
BR2_TARGET_GENERIC_ROOT_PASSWD="licheepi"
BR2_TARGET_GENERIC_GETTY_PORT="ttyS0"
BR2_TARGET_GENERIC_GETTY_BAUDRATE_115200=y
BR2_ROOTFS_POST_BUILD_SCRIPT="$(BR2_EXTERNAL_SQUONK42_PATH)/board/licheepi/post-build.sh"
BR2_ROOTFS_POST_IMAGE_SCRIPT="$(BR2_EXTERNAL_SQUONK42_PATH)/board/licheepi/post-image.sh"
BR2_LINUX_KERNEL=y
BR2_LINUX_KERNEL_CUSTOM_GIT=y
BR2_LINUX_KERNEL_CUSTOM_REPO_URL="https://github.com/Lichee-Pi/linux"
BR2_LINUX_KERNEL_CUSTOM_REPO_VERSION="zero-4.14.y"
BR2_LINUX_KERNEL_DEFCONFIG="licheepi_zero"
BR2_LINUX_KERNEL_DTS_SUPPORT=y
BR2_LINUX_KERNEL_INTREE_DTS_NAME="sun8i-v3s-licheepi-zero sun8i-v3s-licheepi-zero-dock"
BR2_PACKAGE_E2FSPROGS=y
BR2_PACKAGE_E2FSPROGS_RESIZE2FS=y
BR2_PACKAGE_DHCPCD=y
BR2_PACKAGE_WPA_SUPPLICANT=y
BR2_PACKAGE_WPA_SUPPLICANT_AUTOSCAN=y
BR2_TARGET_ROOTFS_EXT2=y
BR2_TARGET_ROOTFS_EXT2_4=y
BR2_TARGET_UBOOT=y
BR2_TARGET_UBOOT_BUILD_SYSTEM_KCONFIG=y
BR2_TARGET_UBOOT_CUSTOM_GIT=y
BR2_TARGET_UBOOT_CUSTOM_REPO_URL="https://github.com/Lichee-Pi/u-boot"
BR2_TARGET_UBOOT_CUSTOM_REPO_VERSION="v3s-current"
BR2_TARGET_UBOOT_BOARD_DEFCONFIG="LicheePi_Zero"
BR2_TARGET_UBOOT_FORMAT_CUSTOM=y
BR2_TARGET_UBOOT_FORMAT_CUSTOM_NAME="u-boot-sunxi-with-spl.bin"
BR2_PACKAGE_HOST_DOSFSTOOLS=y
BR2_PACKAGE_HOST_DTC=y
BR2_PACKAGE_HOST_GENIMAGE=y
BR2_PACKAGE_HOST_MTOOLS=y
BR2_PACKAGE_HOST_UBOOT_TOOLS=y
BR2_PACKAGE_RTL8723BS_EXT=y
```

## squonk42/package/most/Config.in
```kconfig
config BR2_PACKAGE_MOST
	bool "most"
	depends on BR2_PACKAGE_SLANG
	help
	  most is a pager

	  ftp://space.mit.edu/pub/davis/most/

comment "most depends on slang"
	depends on !BR2_PACKAGE_SLANG
```

## template/configs/template_defconfig
```kconfig
BR2_x86_64=y
BR2_TOOLCHAIN_BUILDROOT_MUSL=y
BR2_TARGET_GENERIC_PASSWD_SHA256=y
BR2_ROOTFS_DEVICE_CREATION_DYNAMIC_EUDEV=y
BR2_TARGET_GENERIC_GETTY_PORT="tty1"
BR2_ROOTFS_OVERLAY="$(BR2_EXTERNAL)/board/pc/bootlinux/rootfs-overlay"
BR2_LINUX_KERNEL=y
BR2_LINUX_KERNEL_USE_CUSTOM_CONFIG=y
BR2_LINUX_KERNEL_CUSTOM_CONFIG_FILE="board/pc/linux.config"
BR2_LINUX_KERNEL_XZ=y
BR2_PACKAGE_KEXEC=y
BR2_PACKAGE_KEXEC_ZLIB=y
BR2_PACKAGE_LINUX_FIRMWARE=y
BR2_PACKAGE_LINUX_FIRMWARE_ATHEROS_9170=y
BR2_PACKAGE_LINUX_FIRMWARE_ATHEROS_9271=y
BR2_PACKAGE_LINUX_FIRMWARE_IWLWIFI_3160=y
BR2_PACKAGE_LINUX_FIRMWARE_IWLWIFI_3168=y
BR2_PACKAGE_LINUX_FIRMWARE_IWLWIFI_5000=y
BR2_PACKAGE_LINUX_FIRMWARE_IWLWIFI_6000G2A=y
BR2_PACKAGE_LINUX_FIRMWARE_IWLWIFI_6000G2B=y
BR2_PACKAGE_LINUX_FIRMWARE_IWLWIFI_7260=y
BR2_PACKAGE_LINUX_FIRMWARE_IWLWIFI_7265D=y
BR2_PACKAGE_LINUX_FIRMWARE_IWLWIFI_8000C=y
BR2_PACKAGE_LINUX_FIRMWARE_IWLWIFI_8265=y
BR2_PACKAGE_LINUX_FIRMWARE_RALINK_RT73=y
BR2_PACKAGE_LINUX_FIRMWARE_RALINK_RT2XX=y
BR2_PACKAGE_LINUX_FIRMWARE_RTL_81XX=y
BR2_PACKAGE_LINUX_FIRMWARE_RTL_87XX=y
BR2_PACKAGE_LINUX_FIRMWARE_RTL_88XX=y
BR2_PACKAGE_LINUX_FIRMWARE_RTL_8169=y
BR2_PACKAGE_ACPID=y
BR2_PACKAGE_DBUS=y
BR2_PACKAGE_PARTED=y
BR2_PACKAGE_LIBGLIB2=y
BR2_PACKAGE_READLINE=y
BR2_PACKAGE_SLANG=y
BR2_PACKAGE_IPTABLES=y
BR2_PACKAGE_LINKS=y
BR2_PACKAGE_WPA_SUPPLICANT=y
BR2_PACKAGE_WPA_SUPPLICANT_DBUS_NEW=y
BR2_PACKAGE_DIALOG=y
BR2_TARGET_ROOTFS_CPIO=y
BR2_TARGET_ROOTFS_CPIO_XZ=y
BR2_TARGET_GRUB2=y
BR2_TARGET_GRUB2_X86_64_EFI=y
```

## template/packages/pngphoon/Config.in
```kconfig
config BR2_PACKAGE_PNGPHOON
	bool "pngphoon"
	select BR2_PACKAGE_LIBPNG
	help
	  Tool for creating a monochromatic image of the current phase
	  of the moon.

	  http://svolli.de/software/pngphoon/
```

## v3s/Config.in
```kconfig
source "$BR2_EXTERNAL_V3S_PATH/package/rtl8723bs_ext/Config.in"
source "$BR2_EXTERNAL_V3S_PATH/package/rtl8723bs_bt/Config.in"
source "$BR2_EXTERNAL_V3S_PATH/package/x11vnc_fbonly/Config.in"
```

## v3s/configs/licheepi_zero_defconfig
```kconfig
BR2_arm=y
BR2_cortex_a7=y
BR2_ARM_FPU_VFPV4=y
BR2_DL_DIR="/home/svolli/src/buildroot/dl"
BR2_KERNEL_HEADERS_4_19=y
BR2_ROOTFS_POST_IMAGE_SCRIPT="support/scripts/genimage.sh"
BR2_ROOTFS_POST_SCRIPT_ARGS="-c $(BR2_EXTERNAL_V3S_PATH)/board/licheepi/genimage.cfg"
BR2_LINUX_KERNEL=y
BR2_LINUX_KERNEL_DEFCONFIG="sunxi"
BR2_LINUX_KERNEL_DTS_SUPPORT=y
BR2_LINUX_KERNEL_INTREE_DTS_NAME="sun8i-v3s-licheepi-zero sun8i-v3s-licheepi-zero-dock"
BR2_PACKAGE_DROPBEAR=y
BR2_TARGET_ROOTFS_EXT2=y
BR2_TARGET_ROOTFS_EXT2_4=y
BR2_TARGET_ROOTFS_EXT2_LABEL="LICHEEPI"
BR2_TARGET_ROOTFS_EXT2_RESBLKS=1
BR2_TARGET_UBOOT=y
BR2_TARGET_UBOOT_BOARD_DEFCONFIG="LicheePi_Zero"
BR2_TARGET_UBOOT_NEEDS_DTC=y
BR2_TARGET_UBOOT_NEEDS_PYLIBFDT=y
BR2_TARGET_UBOOT_SPL=y
BR2_TARGET_UBOOT_SPL_NAME="u-boot-sunxi-with-spl.bin"
BR2_TARGET_UBOOT_BOOT_SCRIPT=y
BR2_TARGET_UBOOT_BOOT_SCRIPT_SOURCE="$(BR2_EXTERNAL_V3S_PATH)/board/licheepi/boot.cmd"
BR2_PACKAGE_HOST_DOSFSTOOLS=y
BR2_PACKAGE_HOST_GENIMAGE=y
BR2_PACKAGE_HOST_MTOOLS=y
```

## v3s/configs/licheepi_zero_dock_lcd_defconfig
```kconfig
BR2_arm=y
BR2_cortex_a7=y
BR2_ARM_FPU_VFPV4=y
BR2_TOOLCHAIN_EXTERNAL=y
BR2_TARGET_GENERIC_HOSTNAME="licheepi-zero"
BR2_TARGET_GENERIC_ISSUE="Welcome to Buildroot for the LicheePi Zero Dock"
BR2_TARGET_GENERIC_GETTY_PORT="ttyGS0"
BR2_TARGET_GENERIC_GETTY_BAUDRATE_115200=y
BR2_SYSTEM_DHCP="eth0"
BR2_ROOTFS_OVERLAY="$(BR2_EXTERNAL_V3S_PATH)/board/licheepi-zero/rootfs"
BR2_ROOTFS_POST_IMAGE_SCRIPT="support/scripts/genimage.sh"
BR2_ROOTFS_POST_SCRIPT_ARGS="-c $(BR2_EXTERNAL_V3S_PATH)/board/licheepi-zero/genimage-dock.cfg"
BR2_LINUX_KERNEL=y
BR2_LINUX_KERNEL_CUSTOM_GIT=y
BR2_LINUX_KERNEL_CUSTOM_REPO_URL="https://github.com/Lichee-Pi/linux"
BR2_LINUX_KERNEL_CUSTOM_REPO_VERSION="cda44c146b9b87290bc7c636ffa7d88cbfb03ace"
BR2_LINUX_KERNEL_DEFCONFIG="licheepi_zero"
BR2_LINUX_KERNEL_DTS_SUPPORT=y
BR2_LINUX_KERNEL_INTREE_DTS_NAME="sun8i-v3s-licheepi-zero-dock"
BR2_PACKAGE_BUSYBOX_CONFIG_FRAGMENT_FILES="$(BR2_EXTERNAL_V3S_PATH)/board/licheepi-zero/busybox_enable_extras.config"
BR2_PACKAGE_LINUX_FIRMWARE=y
BR2_PACKAGE_LINUX_FIRMWARE_RTL_87XX=y
BR2_PACKAGE_WPA_SUPPLICANT=y
BR2_PACKAGE_WPA_SUPPLICANT_AUTOSCAN=y
BR2_TARGET_ROOTFS_EXT2=y
BR2_TARGET_ROOTFS_EXT2_4=y
BR2_TARGET_UBOOT=y
BR2_TARGET_UBOOT_BUILD_SYSTEM_KCONFIG=y
BR2_TARGET_UBOOT_CUSTOM_GIT=y
BR2_TARGET_UBOOT_CUSTOM_REPO_URL="https://github.com/Lichee-Pi/u-boot"
BR2_TARGET_UBOOT_CUSTOM_REPO_VERSION="32ab1804cd7c5858be8009e35ca07502dc8765c7"
BR2_TARGET_UBOOT_BOARD_DEFCONFIG="LicheePi_Zero_800x480LCD"
BR2_TARGET_UBOOT_NEEDS_DTC=y
BR2_TARGET_UBOOT_FORMAT_CUSTOM=y
BR2_TARGET_UBOOT_FORMAT_CUSTOM_NAME="u-boot-sunxi-with-spl.bin"
BR2_TARGET_UBOOT_BOOT_SCRIPT=y
BR2_TARGET_UBOOT_BOOT_SCRIPT_SOURCE="$(BR2_EXTERNAL_V3S_PATH)/board/licheepi-zero/boot-dock-lcd.cmd"
BR2_PACKAGE_HOST_DOSFSTOOLS=y
BR2_PACKAGE_HOST_GENIMAGE=y
BR2_PACKAGE_HOST_MTOOLS=y
BR2_PACKAGE_RTL8723BS_EXT=y
```

## v3s/package/rtl8723bs_bt/Config.in
```kconfig
config BR2_PACKAGE_RTL8723BS_BT
	bool "rtl8723bs bluetooth"
	depends on BR2_LINUX_KERNEL
	help
	  rtl8723bs bluetooth driver and firmware

	  https://github.com/bmericc/rtl8723bs_bt

if BR2_PACKAGE_RTL8723BS_BT
config BR2_PACKAGE_RTL8723BS_BT_NEW_FIRMWARE
	bool "Install new firmware"
	help
	  There are two different firmwares available. Use this option to
	  select the newer one.
endif

comment "rtl8723bs_bt needs a Linux kernel to be built"
	depends on !BR2_LINUX_KERNEL
```

## v3s/package/rtl8723bs_ext/Config.in
```kconfig
config BR2_PACKAGE_RTL8723BS_EXT
	bool "rtl8723bs wifi"
	depends on BR2_LINUX_KERNEL
	help
	  rtl8723bs wifi driver

	  https://github.com/hadess/rtl8723bs

if BR2_PACKAGE_RTL8723BS_EXT
config BR2_PACKAGE_RTL8723BS_EXT_NEEDS_SOURCES
	bool "rtl8723bs needs sources (kernel < 4.12)"
	help
	  Select this option then the kernel is < 4.12.
	  It will activate a kernel patch needed in this case.
endif

comment "rtl8723bs needs a Linux kernel to be built"
	depends on !BR2_LINUX_KERNEL
```

## v3s/package/x11vnc_fbonly/Config.in
```kconfig
config BR2_PACKAGE_X11VNC_FBONLY
	bool "x11vnc (framebuffer only)"
	depends on BR2_USE_MMU # fork()
	depends on !BR2_nios2 # libvncserver
	select BR2_PACKAGE_LIBVNCSERVER
	select BR2_PACKAGE_ZLIB
	help
	  VNC server for X11 display, in configuration for raw display only

	  http://www.karlrunge.com/x11vnc/
```
